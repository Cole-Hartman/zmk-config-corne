## config/west.yml
```yaml
manifest:
  remotes:
    - name: urob
      url-base: https://github.com/urob
    - name: mctechnology17 # new
      url-base: https://github.com/mctechnology17 # new
  projects:
    - name: zmk
      remote: urob
      revision: main
      import: app/west.yml
    - name: zmk-helpers
      remote: urob
      revision: main
    - name: zmk-nice-oled # new
      remote: mctechnology17 # new
      revision: main # new
  self:
    path: config
```
